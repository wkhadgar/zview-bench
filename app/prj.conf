## CMakeLists.txt
```
# Copyright (c) 2026 Paulo Santos (@wkhadgar)
# SPDX-License-Identifier: Apache-2.0

cmake_minimum_required(VERSION 3.20.0)
find_package(Zephyr REQUIRED HINTS $ENV{ZEPHYR_BASE})

project(zview_bench LANGUAGES C)

target_include_directories(app PRIVATE src)
target_sources(app PRIVATE
  src/main.c
  src/instrument.c
  src/stack.c
)

# Each mode builds only its own workload.
target_sources_ifdef(CONFIG_ZVIEW_BENCH_MODE_STEADY app PRIVATE src/steady.c)
target_sources_ifdef(CONFIG_ZVIEW_BENCH_MODE_DYNAMIC app PRIVATE
  src/dynamic/heap.c
  src/dynamic/load.c
  src/dynamic/mutex.c
  src/dynamic/sem.c
  src/dynamic/msgq.c
  src/dynamic/slab.c
  src/dynamic/timers.c
)

# Locate the git index for this repository and add it as a dependency of the
# application VERSION file, so a new commit regenerates the version even when
# no build inputs changed. Silently skipped for freestanding (non-git) trees.
find_package(Git QUIET)
if(GIT_FOUND)
  execute_process(
    COMMAND ${GIT_EXECUTABLE} rev-parse --absolute-git-dir
    WORKING_DIRECTORY .
    OUTPUT_VARIABLE application_git_dir
    OUTPUT_STRIP_TRAILING_WHITESPACE
    ERROR_STRIP_TRAILING_WHITESPACE
    ERROR_VARIABLE stderr
    RESULT_VARIABLE return_code
  )
  if(NOT return_code)
    if(NOT "${stderr}" STREQUAL "")
      message(WARNING "Application build version git rev-parse warned: ${stderr}")
    endif()
    set_property(TARGET app_version_h PROPERTY APP_VERSION_DEPENDS ${application_git_dir}/index)
  endif()
endif()
```

## Kconfig
```
# Copyright (c) 2026 Paulo Santos (@wkhadgar)
# SPDX-License-Identifier: Apache-2.0
#
# Application Kconfig entry point. Browse with `west build -t menuconfig`.

choice ZVIEW_BENCH_MODE
	prompt "ZView bench workload mode"
	default ZVIEW_BENCH_MODE_DYNAMIC
	help
	  Selects the workload compiled into the binary. Each mode is its own
	  ELF so the steady-state binary carries no dynamic-mode scaffolding.

config ZVIEW_BENCH_MODE_STEADY
	bool "Steady-state metronome (deviation baseline)"
	help
	  A single memory-bandwidth-bound thread on an absolute-deadline period,
	  instrumented with a cycle counter and an optional GPIO edge. The
	  stationary target for measuring a probe's timing perturbation.

config ZVIEW_BENCH_MODE_DYNAMIC
	bool "Dynamic all-paths workload"
	help
	  Threads that continuously move the state ZView observes: heap
	  fragmentation, CPU load, a deep stack watermark, a contended mutex, a
	  semaphore whose count sweeps its range, and a gate semaphore with
	  threads parked on its wait queue.

endchoice

config ZVIEW_BENCH_PERIOD_MS
	int "Steady-state period (ms)"
	depends on ZVIEW_BENCH_MODE_STEADY
	default 5
	help
	  Absolute-deadline period of the metronome thread.

config ZVIEW_BENCH_STREAM_WORDS
	int "Steady-state working-set size (32-bit words)"
	depends on ZVIEW_BENCH_MODE_STEADY
	default 4096 if SOC_SERIES_RA6E2
	default 8192
	help
	  Size of the streamed buffer. Keep it larger than the data cache so
	  each pass forces main-memory traffic; 8192 words is 32 KiB, twice the
	  Cortex-M7 16 KiB D-cache. The RA6E2 has 40 KiB of RAM, so it takes
	  4096 words (16 KiB) to fit.

config ZVIEW_BENCH_STREAM_PASSES
	int "Steady-state sweeps per period"
	depends on ZVIEW_BENCH_MODE_STEADY
	default 4
	help
	  Number of full read-modify-write sweeps over the working set per
	  period. Sets the deterministic work-window length.

config ZVIEW_BENCH_RUN_MS
	int "Steady-state run length (ms of uptime, 0 to run until stopped)"
	depends on ZVIEW_BENCH_MODE_STEADY
	default 55000
	help
	  The metronome stops at this uptime, so the ring holds the last
	  windows before it and a later read of the ring touches none of them.
	  The default ends it while a 60 s ZView run started after the reset
	  still reads. With 0 it runs until the host sets bench_stop through
	  the probe.

menu "Zephyr"
source "Kconfig.zephyr"
endmenu
```

## sample.yaml
```
sample:
  name: zview-bench
  description: Reference Zephyr target for exercising and benchmarking ZView
common:
  build_only: true
  integration_platforms:
    - nucleo_h753zi
tests:
  app.default: {}
```

## prj.conf
```kconfig
# Copyright (c) 2026 Paulo Santos (@wkhadgar)
# SPDX-License-Identifier: Apache-2.0
#
# Kconfig options that expose the target's runtime state to ZView (mirroring the
# prerequisites in the ZView README) plus the bench instrumentation.

# Thread discovery and stack analysis.
CONFIG_INIT_STACKS=y
CONFIG_THREAD_MONITOR=y
CONFIG_THREAD_STACK_INFO=y
CONFIG_THREAD_NAME=y
CONFIG_THREAD_RUNTIME_STATS=y

# Heap runtime statistics and fragmentation walking.
CONFIG_SYS_HEAP_RUNTIME_STATS=y
CONFIG_SYS_HEAP_ARRAY_SIZE=4

# Peak slab utilisation: a high-water mark, so it holds a spike between two
# polls where the live count does not.
CONFIG_MEM_SLAB_TRACE_MAX_UTILIZATION=y

# Portable cycle timing (DWT CYCCNT on Cortex-M). Share the source with thread
# runtime stats so the two do not contend for the cycle counter.
CONFIG_TIMING_FUNCTIONS=y
CONFIG_THREAD_RUNTIME_STATS_USE_TIMING_FUNCTIONS=y

# External instrumentation edge.
CONFIG_GPIO=y

# Hold the clock fixed: no power-management sleep states that would change
# the timing baseline the experiment measures.
CONFIG_PM=n
```

## boards/zbook_rp2350b_m33.conf
```kconfig
# Copyright (c) 2026 Paulo Santos (@wkhadgar)
# SPDX-License-Identifier: Apache-2.0
#
# The zbook's board defconfig puts a FAT filesystem on its SD card. The bench
# uses neither, and FAT would need the fatfs module in the manifest.
CONFIG_FILE_SYSTEM=n
CONFIG_FAT_FILESYSTEM_ELM=n
```

## boards/fpb_ra6e2.overlay
```dts
/*
 * Copyright (c) 2026 Paulo Santos (@wkhadgar)
 * SPDX-License-Identifier: Apache-2.0
 *
 * button0 is push button S1 (P304), which the board names sw0.
 */

/ {
	aliases {
		button0 = &button0;
	};
};
```

## boards/nucleo_h753zi.overlay
```dts
/*
 * Copyright (c) 2026 Paulo Santos (@wkhadgar)
 * SPDX-License-Identifier: Apache-2.0
 *
 * led0 drives an external probe point for a logic analyzer / scope, giving a
 * target-independent reference for the steady-state period. It is moved off
 * the green user LED (LD1) to PB8, Arduino D15 on the Nucleo-144 header.
 *
 * button0 is the blue user button (B1), which the board names sw0.
 */

/ {
	bench {
		compatible = "gpio-leds";
		bench_toggle: bench_toggle {
			gpios = <&gpiob 8 GPIO_ACTIVE_HIGH>;
		};
	};

	aliases {
		led0 = &bench_toggle;
		button0 = &user_button;
	};
};
```

## boards/zbook.overlay
```dts
/*
 * Copyright (c) 2026 Paulo Santos (@wkhadgar)
 * SPDX-License-Identifier: Apache-2.0
 *
 * bench_toggle drives an external probe point for a logic analyzer / scope.
 * The zbook breaks out no spare header pin, so the red LED is reused. It is
 * active low, so the edge polarity is inverted.
 */

/ {
	aliases {
		bench-toggle = &red_led;
	};
};
```

## src/main.c
```c
/*
 * ZView reference workload.
 *
 * Copyright (c) 2026 Paulo Santos (@wkhadgar)
 * SPDX-License-Identifier: Apache-2.0
 *
 * ZVIEW_BENCH_MODE picks one of two workloads, each built from its own sources:
 *   STEADY  - steady.c, a metronome thread on an absolute deadline, for
 *             measuring a probe's timing perturbation.
 *   DYNAMIC - dynamic/, threads that keep every object ZView reads in motion.
 *
 * In either mode, pressing button0 overflows main's stack on purpose.
 */

#include <errno.h>

#include <zephyr/drivers/gpio.h>
#include <zephyr/kernel.h>
#include <zephyr/sys/atomic.h>
#include <zephyr/sys/printk.h>

#include "bench.h"

/* Optional crash button. A board without the alias builds without it. */
#if DT_NODE_EXISTS(DT_ALIAS(button0))
#define HAVE_CRASH_BUTTON 1
#else
#define HAVE_CRASH_BUTTON 0
#endif

#if HAVE_CRASH_BUTTON

#define CRASH_DEPTH 8

BUILD_ASSERT((CRASH_DEPTH + 1) * 128 > CONFIG_MAIN_STACK_SIZE,
	     "button0 would no longer overflow main's stack");

static const struct gpio_dt_spec crash_button = GPIO_DT_SPEC_GET(DT_ALIAS(button0), gpios);
static struct gpio_callback crash_button_cb;
static atomic_t crash_requested;

/* ISR context, so it only latches the press; main overflows its own stack. */
static void crash_button_pressed(const struct device *port, struct gpio_callback *cb,
				 gpio_port_pins_t pins)
{
	ARG_UNUSED(port);
	ARG_UNUSED(cb);
	ARG_UNUSED(pins);

	atomic_set(&crash_requested, 1);
}

static int crash_button_init(void)
{
	int err;

	if (!gpio_is_ready_dt(&crash_button)) {
		return -ENODEV;
	}

	err = gpio_pin_configure_dt(&crash_button, GPIO_INPUT);
	if (err != 0) {
		return err;
	}

	err = gpio_pin_interrupt_configure_dt(&crash_button, GPIO_INT_EDGE_TO_ACTIVE);
	if (err != 0) {
		return err;
	}

	gpio_init_callback(&crash_button_cb, crash_button_pressed, BIT(crash_button.pin));

	return gpio_add_callback_dt(&crash_button, &crash_button_cb);
}

#endif /* HAVE_CRASH_BUTTON */

int main(void)
{
	instrument_init();

#if defined(CONFIG_ZVIEW_BENCH_MODE_STEADY)
	printk("zview-bench: steady mode, %d ms period\n", CONFIG_ZVIEW_BENCH_PERIOD_MS);
#else
	printk("zview-bench: dynamic mode\n");
#endif

#if HAVE_CRASH_BUTTON
	int err = crash_button_init();

	if (err != 0) {
		printk("zview-bench: button0 unavailable (%d)\n", err);
	}
#endif

	while (1) {
		k_msleep(1000);

#if HAVE_CRASH_BUTTON
		if (atomic_clear(&crash_requested)) {
			printk("zview-bench: button0 pressed, overflowing main's stack\n");
			force_stack_watermark(CRASH_DEPTH);
		}
#endif
	}

	return 0;
}
```

## src/bench.h
```c
/*
 * Copyright (c) 2026 Paulo Santos (@wkhadgar)
 * SPDX-License-Identifier: Apache-2.0
 *
 * Shared by every workload: the thread start delay, the stack watermark
 * helper and the instrumentation, an optional scope edge on led0. Each mode
 * keeps its own record for the host to read after a run: the steady mode a
 * ring of measured periods, the dynamic mode a log of mutex holds.
 */

#ifndef ZVIEW_BENCH_BENCH_H_
#define ZVIEW_BENCH_BENCH_H_

#include <stdint.h>

#include <zephyr/drivers/gpio.h>

/* main() arms the timing source before any thread reads the cycle counter. */
#define BENCH_START_DELAY_MS 10

/* Optional scope edge on led0. A board without the alias builds without it. */
#if DT_NODE_EXISTS(DT_ALIAS(led0))
#define HAVE_TOGGLE 1
extern const struct gpio_dt_spec bench_toggle;
#else
#define HAVE_TOGGLE 0
#endif

void instrument_init(void);

/* Uses depth + 1 frames of 128 bytes and more on the calling thread's stack. */
void force_stack_watermark(int depth);

static inline void toggle_set(int value)
{
#if HAVE_TOGGLE
	if (gpio_is_ready_dt(&bench_toggle)) {
		gpio_pin_set_dt(&bench_toggle, value);
	}
#else
	ARG_UNUSED(value);
#endif
}

#endif /* ZVIEW_BENCH_BENCH_H_ */
```

## src/instrument.c
```c
/*
 * Copyright (c) 2026 Paulo Santos (@wkhadgar)
 * SPDX-License-Identifier: Apache-2.0
 */

#include <zephyr/drivers/gpio.h>
#include <zephyr/timing/timing.h>

#include "bench.h"

#if HAVE_TOGGLE
const struct gpio_dt_spec bench_toggle = GPIO_DT_SPEC_GET(DT_ALIAS(led0), gpios);
#endif

void instrument_init(void)
{
	timing_init();
	timing_start();

#if HAVE_TOGGLE
	if (gpio_is_ready_dt(&bench_toggle)) {
		gpio_pin_configure_dt(&bench_toggle, GPIO_OUTPUT_INACTIVE);
	}
#endif
}
```

## src/stack.c
```c
/*
 * Copyright (c) 2026 Paulo Santos (@wkhadgar)
 * SPDX-License-Identifier: Apache-2.0
 */

#include <string.h>

#include "bench.h"

/* One frame per level. The buffer is read after the call, so it is not reused. */
void force_stack_watermark(int depth)
{
	volatile char bloat[128];

	memset((void *)bloat, 0xBB, sizeof(bloat));
	if (depth > 0) {
		force_stack_watermark(depth - 1);
	}

	(void)bloat[0];
}
```

## src/steady.c
```c
/*
 * Copyright (c) 2026 Paulo Santos (@wkhadgar)
 * SPDX-License-Identifier: Apache-2.0
 *
 * Steady-state mode: a metronome thread on an absolute deadline, for measuring
 * a probe's timing perturbation.
 */

#include <stddef.h>
#include <stdint.h>
#include <string.h>

#include <zephyr/kernel.h>
#include <zephyr/linker/section_tags.h>
#include <zephyr/timing/timing.h>

#if defined(CONFIG_CORTEX_M_DWT)
#include <cmsis_core.h>
#endif

#include "bench.h"

#define METRO_STACK   2048
#define METRO_PRIO    7
#define PERIOD_MS     CONFIG_ZVIEW_BENCH_PERIOD_MS
#define STREAM_WORDS  CONFIG_ZVIEW_BENCH_STREAM_WORDS
#define STREAM_PASSES CONFIG_ZVIEW_BENCH_STREAM_PASSES
#define RUN_MS        CONFIG_ZVIEW_BENCH_RUN_MS

/*
 * Each period's work window, and the time from the start of the previous
 * window to the start of this one, in timing cycles. No-init, so a probe
 * reading these never aliases the measured state; a zero window is never
 * recorded, so zero marks a slot not yet written.
 */
#define BENCH_RING_LEN 1024U
uint32_t bench_period_cycles[BENCH_RING_LEN] __noinit;
uint32_t bench_start_cycles[BENCH_RING_LEN] __noinit;
uint32_t bench_period_head __noinit;

/* The host sets it, through a probe write, to end the run before reading the ring. */
volatile uint32_t bench_stop;

/* Larger than the data cache, so each pass crosses the bus a probe reads. */
static volatile uint32_t stream_buf[STREAM_WORDS];
static volatile uint32_t stream_sink;

static void ring_record(uint32_t window, uint32_t start_to_start)
{
	bench_period_cycles[bench_period_head] = window;
	bench_start_cycles[bench_period_head] = start_to_start;
	bench_period_head = (bench_period_head + 1U) % BENCH_RING_LEN;
}

/*
 * pyOCD clears DEMCR when it closes a session, and the DWT cycle counter stops
 * with TRCENA. Zephyr sets it only at boot, so the metronome sets it again
 * before every window.
 */
static void trace_enable(void)
{
#if defined(CONFIG_CORTEX_M_DWT)
	DCB->DEMCR |= DCB_DEMCR_TRCENA_Msk;
	DWT->CTRL |= DWT_CTRL_CYCCNTENA_Msk;
#endif
}

static bool run_over(void)
{
	return bench_stop != 0U || (RUN_MS > 0 && k_uptime_get() >= RUN_MS);
}

static void do_fixed_work(void)
{
	uint32_t acc = 1U;

	for (int pass = 0; pass < STREAM_PASSES; pass++) {
		for (size_t i = 0; i < STREAM_WORDS; i++) {
			acc += stream_buf[i];
			stream_buf[i] = acc;
		}
	}
	stream_sink = acc;
}

static void metronome(void *p1, void *p2, void *p3)
{
	ARG_UNUSED(p1);
	ARG_UNUSED(p2);
	ARG_UNUSED(p3);

	bench_period_head = 0U;
	memset(bench_period_cycles, 0, sizeof(bench_period_cycles));
	memset(bench_start_cycles, 0, sizeof(bench_start_cycles));

	for (size_t i = 0; i < STREAM_WORDS; i++) {
		stream_buf[i] = (uint32_t)i;
	}

	/* Warm-up, discarded. */
	do_fixed_work();

	int64_t next = k_uptime_ticks();
	const int64_t period_ticks = k_ms_to_ticks_ceil64(PERIOD_MS);
	timing_t prev_t0 = 0;
	bool have_prev = false;

	while (!run_over()) {
		trace_enable();

		timing_t t0 = timing_counter_get();
		toggle_set(1);

		do_fixed_work();

		toggle_set(0);
		timing_t t1 = timing_counter_get();

		/* The 32-bit truncation keeps both differences right across a counter wrap. */
		uint32_t window = (uint32_t)timing_cycles_get(&t0, &t1);
		uint32_t start_to_start = have_prev ? (uint32_t)timing_cycles_get(&prev_t0, &t0) : 0U;

		/* A zero window means the counter stood still, so there is nothing to record. */
		if (window != 0U) {
			ring_record(window, start_to_start);
		}
		prev_t0 = t0;
		have_prev = true;

		next += period_ticks;
		k_sleep(K_TIMEOUT_ABS_TICKS(next));
	}
}

K_THREAD_DEFINE(metro_id, METRO_STACK, metronome, NULL, NULL, NULL, METRO_PRIO, 0,
		BENCH_START_DELAY_MS);
```
